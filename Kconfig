## Kconfig
```kconfig
menuconfig PAW3222
    bool "PAW3222 mouse optical sensor"
    select SPI
    help
      Enable PAW3222 mouse optical sensor.

if PAW3222

config PAW3222_MOVEMENT_THRESHOLD
    int "Movement threshold for auto mouse layer activation"
    default 100
    help
      Minimum accumulated movement (in sensor units) required to trigger
      auto mouse layer activation. Set to 0 to activate on any movement.

config PAW3222_SMART_ALGORITHM
    bool "Enable smart movement algorithm"
    default y
    help
      Enable intelligent movement processing for improved tracking accuracy
      and responsiveness. This includes movement filtering and acceleration
      curves similar to PMW3610 smart algorithm.

config PAW3222_SCROLL_LAYERS
    int "Default scroll layer index"
    default 4
    help
      Default layer index for scroll mode when trackball movement
      is converted to scroll wheel events.

config PAW3222_AUTOMOUSE_LAYER
    int "Default auto mouse layer index"
    default 5
    help
      Default layer index to activate when movement is detected above
      the configured threshold.

config PAW3222_TIMEOUT_MS
    int "Auto mouse timeout in milliseconds"
    default 600
    range 100 5000
    help
      Milliseconds of inactivity before automatically returning to base layer.
      Set to a higher value for longer mouse mode sessions.

config PAW3222_DEBUG
    bool "Enable PAW3222 debug logging"
    default n
    help
      Enable detailed debug logging for PAW3222 sensor operations,
      movement detection, and layer switching.

endif # PAW3222
```

## dts/bindings/pixart,paw3222.yaml
```yaml
# Copyright 2024 Google LLC
# Copyright 2025 sekigon-gonnoc
# SPDX-License-Identifier: Apache-2.0

description: PAW32xx ultra low power wireless mouse chip

compatible: "pixart,paw3222"

include: spi-device.yaml

properties:
  irq-gpios:
    type: phandle-array
    required: true
    description:
      GPIO connected to the motion pin, active low.

  power-gpios:
    type: phandle-array
    required: false
    description:
      GPIO connected to the power control pin.

  res-cpi:
    type: int
    description: |
      CPI resolution for the sensor. This can also be changed in runtime using
      the paw32xx_set_resolution() API.

  force-awake:
    type: boolean
    description: |
      Initialize the sensor in "force awake" mode. This can also be enabled or
      disabled in runtime by the application using the paw32xx_force_awake()
      API.

  automouse-layer:
    type: int
    description: |
      Layer index to activate when movement is detected. When movement is
      detected above the threshold, the keyboard will automatically switch
      to this layer for mouse operations.

  scroll-layers:
    type: int
    description: |
      Layer index for scroll mode. When this layer is active, trackball
      movement will be converted to scroll wheel events.

  movement-timeout-ms:
    type: int
    default: 600
    description: |
      Milliseconds of inactivity before automatically returning to base layer.
      Set to 0 to disable timeout.

  movement-threshold:
    type: int
    default: 100
    description: |
      Minimum accumulated movement (in sensor units) required to trigger
      auto mouse layer activation. Lower values make the sensor more sensitive.
```
